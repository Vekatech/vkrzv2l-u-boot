## board/renesas/vk-d184280e/Kconfig
```kconfig
if TARGET_VK_D184280E || TARGET_VK_D184280E_1

config SYS_SOC
        default "rmobile"

config SYS_BOARD
        default "vk-d184280e"

config SYS_VENDOR
        default "renesas"

config SYS_CONFIG_NAME
        default "vk-d184280e"

config SYS_MMC_DEV
	int
	default 1 if ENV_IS_IN_SPI_FLASH
	default 0

config SYS_MMC_IMG_LOAD_PART
	int
	default 1

config SYS_USB_DEV
	int
	default 0

config SYS_USB_IMG_LOAD_PART
	int
	default 1

endif
```

## board/renesas/vkcmv2l/Kconfig
```kconfig
if TARGET_VKCMV2L

config SYS_SOC
        default "rmobile"

config SYS_BOARD
        default "vkcmv2l"

config SYS_VENDOR
        default "renesas"

config SYS_CONFIG_NAME
        default "vkcmv2l"

config SYS_MMC_DEV
	int
	default 0

config SYS_MMC_IMG_LOAD_PART
	int
	default 1

config OPENCVA
	int
	default 1

config SYS_USB_DEV
	int
	default 0

config SYS_USB_IMG_LOAD_PART
	int
	default 1

endif
```

## board/renesas/vkrzg2l/Kconfig
```kconfig
if TARGET_VKRZG2L

config SYS_SOC
        default "rmobile"

config SYS_BOARD
        default "vkrzg2l"

config SYS_VENDOR
        default "renesas"

config SYS_CONFIG_NAME
        default "vkrzg2l"

config SYS_MMC_DEV
	int
	default 0

config SYS_MMC_IMG_LOAD_PART
	int
	default 1

config SYS_USB_DEV
	int
	default 0

config SYS_USB_IMG_LOAD_PART
	int
	default 1
endif
```

## board/renesas/vkrzg2ul/Kconfig
```kconfig
if TARGET_VKRZG2UL

config SYS_SOC
        default "rmobile"

config SYS_BOARD
        default "vkrzg2ul"

config SYS_VENDOR
        default "renesas"

config SYS_CONFIG_NAME
        default "vkrzg2ul"

config SYS_MMC_DEV
	int
	default 1 if ENV_IS_IN_SPI_FLASH
	default 0

config SYS_MMC_IMG_LOAD_PART
	int
	default 1

config SYS_USB_DEV
	int
	default 0

config SYS_USB_IMG_LOAD_PART
	int
	default 1

endif
```

## board/renesas/vkrzv2l/Kconfig
```kconfig
if TARGET_VKRZV2L

config SYS_SOC
        default "rmobile"

config SYS_BOARD
        default "vkrzv2l"

config SYS_VENDOR
        default "renesas"

config SYS_CONFIG_NAME
        default "vkrzv2l"

config SYS_MMC_DEV
	int
	default 0

config SYS_MMC_IMG_LOAD_PART
	int
	default 1

config OPENCVA
	int
	default 0

endif
```

## configs/vkcmg2lc_1-emmc_defconfig
```kconfig
CONFIG_USB_GADGET=y
CONFIG_USB_RENESAS_USBHS=y
CONFIG_USB_FUNCTION_FASTBOOT=y
CONFIG_FASTBOOT_BUF_ADDR=0x4D000000
CONFIG_FASTBOOT_BUF_SIZE=0x8000000
CONFIG_FASTBOOT_USB_DEV=1
CONFIG_FASTBOOT_MMC_BOOT_SUPPORT=y
CONFIG_FASTBOOT_MMC_BOOT1_NAME="mmc0boot0"
CONFIG_FASTBOOT_MMC_BOOT2_NAME="mmc0boot1"
CONFIG_FASTBOOT_MMC_USER_SUPPORT=y
CONFIG_FASTBOOT_MMC_USER_NAME="mmc0"
CONFIG_FASTBOOT_GPT_NAME="gpt"
CONFIG_FASTBOOT_MBR_NAME="mbr"
CONFIG_FASTBOOT_FLASH=y
#On RZ/G2L 0 is eMMC - 1 is SDCard.
CONFIG_FASTBOOT_FLASH_MMC_DEV=0
CONFIG_USB_GADGET_MANUFACTURER="Renesas"
CONFIG_USB_GADGET_VENDOR_NUM=0x18D1
CONFIG_USB_GADGET_PRODUCT_NUM=0x4E23
CONFIG_CMD_FASTBOOT=y
CONFIG_USB_FUNCTION_MASS_STORAGE=y
CONFIG_CMD_USB_MASS_STORAGE=y
CONFIG_ARM=y
CONFIG_ARCH_CPU_INIT=y
CONFIG_ARCH_RMOBILE=y
CONFIG_SYS_TEXT_BASE=0x50000000
CONFIG_DM_GPIO=y
CONFIG_RCAR_GEN3=y
CONFIG_R9A07G044C=y
CONFIG_TARGET_VKCMG2LC_1=y
CONFIG_SPL=n
CONFIG_DEFAULT_DEVICE_TREE="vkcmg2lc_1"
CONFIG_SMBIOS_PRODUCT_NAME=""
# CONFIG_ANDROID_BOOT_IMAGE is not set
CONFIG_FIT=y
CONFIG_USE_BOOTARGS=y
CONFIG_BOOTARGS="rw rootwait earlycon root=/dev/mmcblk0p1 ${extrabootargs}"
CONFIG_SUPPORT_RAW_INITRD=y
CONFIG_DEFAULT_FDT_FILE="vkcmg2lc_1.dtb"
CONFIG_VERSION_VARIABLE=y
CONFIG_CMD_CM33=y
CONFIG_HUSH_PARSER=y
CONFIG_CMD_BOOTZ=y
CONFIG_CMD_GPIO=y
CONFIG_CMD_I2C=y
CONFIG_CMD_SPI=y
CONFIG_CMD_MMC=y
CONFIG_CMD_PCI=y
CONFIG_CMD_USB=y
CONFIG_CMD_DHCP=y
CONFIG_CMD_MII=y
CONFIG_CMD_PING=y
CONFIG_CMD_EXT2=y
CONFIG_CMD_EXT4=y
CONFIG_CMD_EXT4_WRITE=y
CONFIG_CMD_FAT=y
CONFIG_CMD_FS_GENERIC=y
CONFIG_OF_CONTROL=y
CONFIG_OF_LIST="vkcmg2lc_1"
CONFIG_MULTI_DTB_FIT_LZO=y
CONFIG_MULTI_DTB_FIT_USER_DEFINED_AREA=y
CONFIG_ENV_OVERWRITE=y
#
CONFIG_ENV_IS_IN_MMC=y
CONFIG_SYS_MMC_ENV_DEV=0
CONFIG_SYS_MMC_ENV_PART=1
CONFIG_ENV_SIZE=0x20000
CONFIG_ENV_OFFSET=0xFFFE0000
#
CONFIG_SYS_RELOC_GD_ENV_ADDR=y
CONFIG_NET_RANDOM_ETHADDR=y
CONFIG_REGMAP=y
CONFIG_SYSCON=y
CONFIG_CLK=y
CONFIG_CLK_RENESAS=y
CONFIG_CLK_R9A07G044L=y
CONFIG_UDP_FUNCTION_FASTBOOT=y
#CONFIG_FASTBOOT_BUF_ADDR=0x82000000
#CONFIG_FASTBOOT_FLASH=y
#CONFIG_FASTBOOT_FLASH_MMC_DEV=0
CONFIG_RCAR_GPIO=y
CONFIG_RZG2L_GPIO=y
CONFIG_DM=y
CONFIG_DM_I2C=y
CONFIG_MISC=y
CONFIG_SYS_I2C_RCAR_IIC=y
CONFIG_SYS_I2C_RZG2L_RIIC=y
CONFIG_SH_SDHI=y
CONFIG_BITBANGMII=y
CONFIG_PHY_REALTEK=y
CONFIG_DM_ETH=y
CONFIG_RENESAS_RAVB=y
CONFIG_PCI=y
CONFIG_DM_PCI=y
CONFIG_PCI_RCAR_GEN3=y
CONFIG_PINCTRL_PFC_RZG2L=y
CONFIG_DM_REGULATOR=y
CONFIG_DM_REGULATOR_FIXED=y
CONFIG_DM_REGULATOR_GPIO=y
CONFIG_SCIF_CONSOLE=y
CONFIG_TEE=y
CONFIG_OPTEE=y
CONFIG_USB=y
CONFIG_DM_USB=y
CONFIG_USB_XHCI_HCD=y
CONFIG_USB_EHCI_HCD=y
CONFIG_USB_EHCI_GENERIC=y
CONFIG_USB_STORAGE=y
CONFIG_OF_LIBFDT_OVERLAY=y
CONFIG_SMBIOS_MANUFACTURER=""
CONFIG_WDT=y
CONFIG_RENESAS_RZG2LWDT=y
CONFIG_CMD_WDT=y
CONFIG_BOARD_LATE_INIT=y
CONFIG_CMD_EEPROM=y
CONFIG_I2C_SET_DEFAULT_BUS_NUM=y
CONFIG_I2C_DEFAULT_BUS_NUMBER=0
CONFIG_I2C_EEPROM=y
CONFIG_SYS_I2C_EEPROM_ADDR=0x50
CONFIG_SYS_I2C_EEPROM_BUS=0
CONFIG_SYS_I2C_EEPROM_ADDR_LEN=1
CONFIG_SPI_FLASH=y
CONFIG_SPI_FLASH_BAR=y
CONFIG_SPI_FLASH_USE_4K_SECTORS=y
CONFIG_SPI=y
CONFIG_DM_SPI=y
CONFIG_RENESAS_RPC_SPI=y
CONFIG_CMD_SF=y
CONFIG_SPI_FLASH_MACRONIX=y
CONFIG_DM_SPI_FLASH=y
CONFIG_PCA953X=y
CONFIG_DM_PCA953X=y
CONFIG_CMD_PCA953X=y
CONFIG_SYS_I2C_PCA953X_ADDR=0x70
CONFIG_SYS_I2C_PCA953X_WIDTH=8
```
